## conf/distro/dimitriOS.conf
```bitbake
require conf/distro/poky.conf

DISTRO = "dimitriOS"
DISTRO_NAME = "dimitriOS"

BB_NUMBER_THREADS ?= "${@oe.utils.cpu_count()}"
PARALLEL_MAKE ?= "-j ${@oe.utils.cpu_count()}"

SYSTEMD_BOOT_TIMEOUT := "0"

HOSTTOOLS += "ldconfig"

PACKAGE_CLASSES ?= " package_rpm"
EXTRA_IMAGE_FEATURES += "dbg-pkgs"

DISTRO_FEATURES_append = " wifi systemd"
DISTRO_FEATURES_BACKFILL_CONSIDERED += "sysvinit"
VIRTUAL-RUNTIME_init_manager = "systemd"
VIRTUAL-RUNTIME_initscripts = ""
PREFERRED_PROVIDER_udev ?= "systemd"
PREFERRED_PROVIDER_udev-utils ?= "systemd"

hostname_pn-base-files = "dimitrios"

IMAGE_FSTYPES = "rpi-sdimg"
IMAGE_OVERHEAD_FACTOR = "1.5"
IMAGE_INSTALL_append = " linux-firmware-rpidistro-bcm43430 kernel-module-brcmfmac"

CORE_IMAGE_EXTRA_INSTALL += "openssh"
CORE_IMAGE_EXTRA_INSTALL += "usbutils"
```

## conf/layer.conf
```bitbake
# We have a conf and classes directory, add to BBPATH
BBPATH .= ":${LAYERDIR}"

# We have recipes-* directories, add to BBFILES
BBFILES += "${LAYERDIR}/recipes-*/*/*.bb \
            ${LAYERDIR}/recipes-*/*/*.bbappend"

BBFILE_COLLECTIONS += "dimitriOS"
BBFILE_PATTERN_dimitriOS = "^${LAYERDIR}/"
BBFILE_PRIORITY_dimitriOS = "10"

LAYERSERIES_COMPAT_dimitriOS = "zeus"
```
